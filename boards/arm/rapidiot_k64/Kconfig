## boards/arm/rapidiot_k64/Kconfig
```kconfig
# Kconfig - Rapid IoT K64 board
#
# Copyright (c) 2017, NXP
#
# SPDX-License-Identifier: Apache-2.0
#

if BOARD_RAPIDIOT_K64

config BATTERY_SENSE
	bool "Enable the battery sense circuit"

endif # BOARD_RAPIDIOT_K64
```

## boards/arm/rapidiot_k64/Kconfig.board
```kconfig
# Kconfig - Rapid IoT K64 board
#
# Copyright (c) 2016, Freescale Semiconductor, Inc.
#
# SPDX-License-Identifier: Apache-2.0
#

config BOARD_RAPIDIOT_K64
	bool "NXP Rapid IoT K64"
	depends on SOC_SERIES_KINETIS_K6X
	select SOC_PART_NUMBER_MK64FN1M0VDC12
```

## boards/arm/rapidiot_kw41z/Kconfig.board
```kconfig
# Kconfig - Rapid IoT KW41Z board
#
# Copyright (c) 2017, NXP
# Copyright (c) 2019, Marcio Montenegro
#
# SPDX-License-Identifier: Apache-2.0
#

config BOARD_RAPIDIOT_KW41Z
	bool "Rapid IoT KW41Z"
	depends on SOC_SERIES_KINETIS_KWX
	select SOC_PART_NUMBER_MKW41Z512VHT4
```
